## build/conf/bblayers.conf
```bitbake
# POKY_BBLAYERS_CONF_VERSION is increased each time build/conf/bblayers.conf
# changes incompatibly
POKY_BBLAYERS_CONF_VERSION = "2"

BBPATH = "${TOPDIR}"
BBFILES ?= ""

BBLAYERS ?= " \
  /home/server/dev/vm-server-docker/poky/meta \
  /home/server/dev/vm-server-docker/poky/meta-poky \
  /home/server/dev/vm-server-docker/poky/meta-yocto-bsp \
  "
```
